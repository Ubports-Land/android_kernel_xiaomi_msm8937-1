## backports/Kconfig
```kconfig
config BACKPORT_INTEGRATE
	bool
	def_bool y

config BACKPORT_DIR
	string
	default "%%BACKPORT_DIR%%"

config BACKPORT_VERSION
	string
	default "%%BACKPORTS_VERSION%%"

config BACKPORT_KERNEL_VERSION
	string
	default "%%BACKPORTED_KERNEL_VERSION%%"

config BACKPORT_KERNEL_NAME
	string
	default "%%BACKPORTED_KERNEL_NAME%%"

menuconfig BACKPORT_LINUX
	bool "Backport %%BACKPORTED_KERNEL_NAME%% %%BACKPORTED_KERNEL_VERSION%% (backports %%BACKPORTS_VERSION%%)"
	default n
	---help---
	  Enabling this will let give you the opportunity to use features and
	  drivers backported from %%BACKPORTED_KERNEL_NAME%% %%BACKPORTED_KERNEL_VERSION%%
	  on the kernel your are using. This is experimental and you should
	  say no unless you'd like to help test things or want to help debug
	  this should we run into any issues.

if BACKPORT_LINUX

%%KCONFIG_VERSIONS%%

# this has the configuration for the backport code
source "$BACKPORT_DIR/compat/Kconfig"

# these are copied from the kernel
source "$BACKPORT_DIR/net/bluetooth/Kconfig"

source "$BACKPORT_DIR/net/6lowpan/Kconfig"
source "$BACKPORT_DIR/net/ieee802154/Kconfig"
source "$BACKPORT_DIR/net/mac802154/Kconfig"

endif # BACKPORT_LINUX
```
